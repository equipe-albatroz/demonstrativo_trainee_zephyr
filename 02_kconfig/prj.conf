## CMakeLists.txt
```
cmake_minimum_required(VERSION 3.20.0)

set(SNIPPET cdc-acm-console)   # console sai pelo proprio cabo USB da placa

find_package(Zephyr REQUIRED HINTS $ENV{ZEPHYR_BASE})
project(kconfig)

target_sources(app PRIVATE src/main.c)
```

## Kconfig
```
mainmenu "Demonstracao 2 - Kconfig"

choice
	prompt "Cor do pisca"
	default COR_VERMELHO

config COR_VERMELHO
	bool "Vermelho"

config COR_VERDE
	bool "Verde"

config COR_AZUL
	bool "Azul"

endchoice

config PISCA_MS
	int "Meio periodo do pisca, em ms"
	default 500

source "Kconfig.zephyr"
```

## prj.conf
```kconfig
CONFIG_LOG=y

CONFIG_LED_STRIP=y
CONFIG_WS2812_STRIP_RPI_PICO_PIO=y

CONFIG_COR_AZUL=n
CONFIG_COR_VERDE=y
CONFIG_COR_VERMELHO=n
CONFIG_PISCA_MS=1000
```

## src/main.c
```c
#include <zephyr/kernel.h>
#include <zephyr/device.h>
#include <zephyr/drivers/led_strip.h>
#include <zephyr/logging/log.h>

LOG_MODULE_REGISTER(kconfig);

static const struct device *led = DEVICE_DT_GET(DT_ALIAS(led_strip));

#if defined(CONFIG_COR_VERMELHO)
static struct led_rgb cor = { .r = 64 };
#elif defined(CONFIG_COR_VERDE)
static struct led_rgb cor = { .g = 64 };
#else
static struct led_rgb cor = { .b = 64 };
#endif

static struct led_rgb apagado;

int main(void)
{
    if (!device_is_ready(led)) {
        LOG_ERR("led_strip nao esta pronto");
        return 0;
    }

    LOG_INF("piscando a cada %d ms", CONFIG_PISCA_MS);

    while (1) {
        led_strip_update_rgb(led, &cor, 1);
        k_sleep(K_MSEC(CONFIG_PISCA_MS));

        led_strip_update_rgb(led, &apagado, 1);
        k_sleep(K_MSEC(CONFIG_PISCA_MS));
    }
}
```
